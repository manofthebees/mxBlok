## config/boards/shields/mxBlok/Kconfig.defconfig
```kconfig
if SHIELD_MXBLOK_LEFT
 
config ZMK_KEYBOARD_NAME
    default "mxBlok"
 
config ZMK_SPLIT_ROLE_CENTRAL
    default y
 
endif
 
if SHIELD_MXBLOK_LEFT || SHIELD_MXBLOK_RIGHT
 
config ZMK_SPLIT
    default y
 
endif
```

## config/boards/shields/mxBlok/Kconfig.shield
```kconfig
config SHIELD_MXBLOK_LEFT
    def_bool $(shields_list_contains,mxBlok_left)
    select SHIELD_MXBLOK

config SHIELD_MXBLOK_RIGHT
    def_bool $(shields_list_contains,mxBlok_right)
    select SHIELD_MXBLOK
```
